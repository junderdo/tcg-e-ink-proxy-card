## firmware/main/Kconfig.projbuild
```kconfig
menu "e-Paper pins"

    config EPD_PIN_DIN
        int "DIN (MOSI)"
        default 5

    config EPD_PIN_CLK
        int "CLK (SCK)"
        default 6

    config EPD_PIN_CS
        int "CS"
        default 1

    config EPD_PIN_DC
        int "DC"
        default 2

    config EPD_PIN_RST
        int "RST"
        default 3

    config EPD_PIN_BUSY
        int "BUSY"
        default 4

    config EPD_PIN_PWR
        int "PWR"
        default 7

endmenu
```

## firmware/sdkconfig.defaults
```kconfig
CONFIG_IDF_TARGET="esp32s3"
CONFIG_BT_ENABLED=y
CONFIG_BT_NIMBLE_ENABLED=y
CONFIG_BT_NIMBLE_SVC_GAP_DEVICE_NAME="TCG Proxy Card"
CONFIG_BT_NIMBLE_ATT_PREFERRED_MTU=517
CONFIG_PARTITION_TABLE_CUSTOM=y
CONFIG_PARTITION_TABLE_CUSTOM_FILENAME="partitions.csv"
```
